## docs/research/pedometer-bench-2026-08-28/probe/sdkconfig.defaults
```kconfig
CONFIG_IDF_TARGET="esp32s3"
CONFIG_APP_BUILD_TYPE_RAM=y
CONFIG_APP_BUILD_TYPE_PURE_RAM_APP=y
CONFIG_ESP_CONSOLE_USB_SERIAL_JTAG=y
CONFIG_LOG_DEFAULT_LEVEL_INFO=y
CONFIG_ESP_TASK_WDT_INIT=n
```

## firmware/main/Kconfig.projbuild
```kconfig
menu "Attadipa firmware"

choice ATTADIPA_BOARD
    prompt "Board this image is composed for"
    default ATTADIPA_BOARD_WAVESHARE_AMOLED_206
    help
        main/ is the composition root (CMakeLists.txt): the one place that
        may know which board answers, so this is where it is chosen.
        Everything above it asks the board profile what the device can do.

config ATTADIPA_BOARD_WAVESHARE_AMOLED_206
    bool "Waveshare ESP32-S3-Touch-AMOLED-2.06"

config ATTADIPA_BOARD_TWATCH_S3_PLUS
    bool "LilyGO T-Watch S3 Plus (bring-up: panel, touch, rails)"
    help
        First slice (#417): ST7789 panel, FT6336U touch and ALDO2/ALDO3.
        No RTC, NVS, physical input or sleep yet. Stack sdkconfig.twatch on
        sdkconfig.defaults; it also sets the flash mode the factory image
        uses.

endchoice

config ATTADIPA_TWATCH_PANEL_RESET_EXTRA_MS
    int "Extra wait after the ST7789 software reset, ms"
    depends on ATTADIPA_BOARD_TWATCH_S3_PLUS
    default 100
    range 0 1000
    help
        ESP-IDF waits 20 ms after SWRESET; the ST7789V3 datasheet asks for
        120 ms before SLPOUT from sleep-in. 100 is arm C of the experiment
        in docs/research/TWATCH_S3_PLUS_BSP_REUSE.md section 11; 0 is arm
        A, the driver as shipped.

config ATTADIPA_TWATCH_PANEL_INVERT
    bool "Invert the panel's colours (INVON), as the vendor does"
    depends on ATTADIPA_BOARD_TWATCH_S3_PLUS
    default y
    help
        SWRESET leaves the ST7789 with inversion off. LilyGoLib sends INVON
        (21h) through the panel API rather than from its command table
        (TWATCH_S3_PLUS_BSP_REUSE.md section 5), so arm B does not carry it
        and it has to be a choice of its own. Whether this panel wants it is
        what the section 11 swatch photographs: inverted, red reads cyan
        and the white block black.

config ATTADIPA_TWATCH_PANEL_VENDOR_TABLE
    bool "Send LilyGO's panel command table after init (arm B)"
    depends on ATTADIPA_BOARD_TWATCH_S3_PLUS
    default n
    help
        The MIT-licensed table transcribed in TWATCH_S3_PLUS_BSP_REUSE.md
        section 5, sent as data over esp_lcd_panel_io_tx_param(). Only if
        arm C shows nothing; whether it is needed is UNKNOWN until the
        photograph.

config ATTADIPA_WATCH_CONTROL
    bool "USB watch-control endpoint"
    # The endpoint is wired through the Waveshare backend and physical_input;
    # the T-Watch slice has neither yet, so the choice is refused rather than
    # failing at the link.
    depends on ATTADIPA_BOARD_WAVESHARE_AMOLED_206
    default n
    # The screenshot opcode calls lv_snapshot_take_to_draw_buf(), which LVGL
    # compiles out under LV_USE_SNAPSHOT=n -- and n is its own default. Without
    # this line the two symbols that must move together lived in two files with
    # nothing joining them, and turning the endpoint on the obvious way (this
    # menu, then a build) failed at the link rather than at the choice.
    select LV_USE_SNAPSHOT
    help
        Enable the debug control plane over USB-Serial/JTAG: screenshots,
        remote input, and the time and mesh provisioning opcodes. Any host
        that can open the port can use all of it; there is no
        authentication, so this is a bench image rather than a product one.
        Physical touch and the case buttons are NOT gated by this symbol --
        they live in physical_input.cpp and are in every image (#346).
        The feature owns one full RGB565 frame in PSRAM while running, and
        selects LV_USE_SNAPSHOT, which its screenshot opcode needs.

config ATTADIPA_I2C_PROBE
    bool "I2C bring-up probe"
    default n
    help
        Scan the I2C bus on the pins below and log every address that
        acknowledges, then read the AXP2101 charge-voltage register if one
        answered. A bring-up instrument for a board this firmware has no
        driver for; it writes no register and asserts no board identity.

config ATTADIPA_I2C_PROBE_SDA
    int "I2C probe SDA GPIO"
    depends on ATTADIPA_I2C_PROBE
    default 10

config ATTADIPA_I2C_PROBE_SCL
    int "I2C probe SCL GPIO"
    depends on ATTADIPA_I2C_PROBE
    default 11

config ATTADIPA_GNSS_BRIDGE
    bool "GNSS bring-up bridge"
    depends on ATTADIPA_BOARD_TWATCH_S3_PLUS
    default n
    help
        Ask the T-Watch GNSS module what it is. This sweeps baud rate and
        UART orientation until something answers, logs what the port
        carries, then sends version queries in u-blox, ALLYSTAR and three
        ASCII dialects. It writes no GNSS configuration and saves nothing;
        a silent port is logged as a silent port.

        It has already answered its two questions, on the owner's unit, on
        2026-09-05: A2 -- which part is fitted -- came back MOD=MIA-M10Q
        from the module itself, and D6 -- which PMU rail powers it -- came
        back BLDO1 with DCDC3 clear. Both rows are struck through in
        docs/research/OPEN_QUESTIONS.md and the run is written up in
        docs/research/TWATCH_GNSS_READOFF_2026-09-05.md. Keep this build
        for a unit that has not been read off: the product ships MIA-M10Q
        or Quectel LS550G and one read-off retires neither possibility for
        anyone else's watch. On a unit already read off it tells you
        nothing new, and ATTADIPA_GNSS_LOCAL is what you want instead.

        Enabling this brings BLDO1 up at 3.3 V during rail bring-up, early,
        because the sweep runs after the UI has returned and needs the rail
        up however that call ended. ATTADIPA_GNSS_LOCAL needs the same rail
        but raises it itself, later, next to the port it opens -- so this
        is no longer the only build that needs BLDO1, only the one that
        needs it first.

config ATTADIPA_GNSS_BRIDGE_PASSTHROUGH
    bool "GNSS bridge: hand the port to the host when the sweep is done"
    depends on ATTADIPA_GNSS_BRIDGE
    default y
    help
        After identification, carry bytes both ways between USB and the
        module so a host probe written for a bench module runs against the
        watch unchanged. The console is the same USB peripheral, so this
        turns logging off: a stray log line inside a binary frame is a
        corrupt reply the host cannot tell from a corrupt module. Power-
        cycle to get the log stream back.

config ATTADIPA_GNSS_BRIDGE_PIN_A
    int "GNSS bridge GPIO A"
    depends on ATTADIPA_GNSS_BRIDGE
    default 42

config ATTADIPA_GNSS_BRIDGE_PIN_B
    int "GNSS bridge GPIO B"
    depends on ATTADIPA_GNSS_BRIDGE
    default 41
    help
        The schematic pair, from HARDWARE_MATRIX.md's GNSS row: "UART: TX
        42, RX 41". That row does not say whose TX it is, so the bridge
        tries both orientations and reports which one answered rather than
        assuming; these two are a pair, not a fixed rx/tx assignment.

config ATTADIPA_GNSS_LOCAL
    bool "Local GNSS receiver on this board's UART"
    # Not alongside the bridge. On the T-Watch both want GPIO 41, and two UART
    # drivers on one pin is a configuration error worth refusing at the prompt
    # rather than meeting as silence on a bench. They are also two stages of
    # one job: the bridge is the instrument that asks the module what it is,
    # this is the driver that uses the answer, and an image needs one of them.
    depends on !ATTADIPA_GNSS_BRIDGE
    default n
    help
        Listen for NMEA on this board's GNSS receive pin and turn what
        arrives into this device's own position.

        Off by default on both boards, for opposite reasons. Nothing is
        fitted to the Waveshare (HARDWARE_MATRIX.md, GNSS row: "absent"),
        so enabling it there is the configuration change that says you
        soldered a module onto the pads. The T-Watch has one and it has
        been read off -- a u-blox MIA-M10Q -- but this image is still the
        bring-up slice, so listening to it is opt-in until something above
        asks for a position.

        Receive only. Nothing is transmitted to the module and this end's
        TX stays unrouted, so no GNSS configuration can be written or
        saved on either board.

        No new task and no new queue. On the Waveshare the UART driver's
        RX ring is read from the tick that already draws the screen; the
        T-Watch bring-up image has no such tick, so board code there
        registers one LVGL timer, which runs on the LVGL port's existing
        task.

config ATTADIPA_GNSS_LOCAL_RX
    int "GNSS receive GPIO"
    depends on ATTADIPA_GNSS_LOCAL
    default 41 if ATTADIPA_BOARD_TWATCH_S3_PLUS
    default 44 if ATTADIPA_BOARD_WAVESHARE_AMOLED_206
    default 0
    help
        A third board gets 0, which is a refusal and not a pin. The symbol
        above is offered on any board -- that is the point of #442 -- but a
        pin is a per-board fact and this file only has two of them. 0 is not
        a plausible wrong answer that boots: GPIO 0 is a strap, and
        local_gnss.cpp refuses to compile on it, so a new board declares its
        pin here or does not build with the receiver on. Silence was the
        alternative, and silence would have listened on the strap pin.

        This is the pin the CPU listens on, so it is the module's TX in
        both defaults below.

        Waveshare 44 -- the RXD pad, VERIFIED.
        docs/research/WAVESHARE_BOARD_RECEIVED.md's pad table, row 7:
        "| 7 | `RXD` | UART0 receive -- **GPIO 44** |". The orientation was
        never ambiguous here.

        T-Watch 41 -- MEASURED on the bench unit 2026-09-05 by sweeping
        both orientations, which is what firmware/main/gnss_bridge.cpp
        exists to do. docs/research/TWATCH_GNSS_READOFF_2026-09-05.md's
        §2: "So **GPIO 41 is the module's TX and GPIO 42 its RX**". The
        HARDWARE_MATRIX.md row that reads "UART: TX 42, RX 41" is written
        from the CPU's side and agrees; it was correct and ambiguous at
        once, and the sweep left only the correct half.

        The pin is settled on both boards; the level on it is not settled
        on either. H18 in docs/research/OPEN_QUESTIONS.md stays PARTIAL
        because no bench module's TX idle voltage has been measured and
        the S3 is not 5 V tolerant. NOT MEASURED is the whole claim -- put
        a meter on the module's TX before it reaches a pin.

config ATTADIPA_GNSS_LOCAL_BAUD
    int "GNSS UART baud"
    depends on ATTADIPA_GNSS_LOCAL
    default 38400 if ATTADIPA_BOARD_TWATCH_S3_PLUS
    default 115200 if ATTADIPA_BOARD_WAVESHARE_AMOLED_206
    default 0
    help
        0 on a board that names no speed, refused at compile time for the
        same reason as the pin above.

        Waveshare 115200 -- MEASURED for the GT-U12 on the bench (#427).

        T-Watch 38400 -- MEASURED on the bench unit 2026-09-05, in the same
        sweep that settled the pin, and the speed LilyGoLib@38e6f8d
        src/LilyGoWatchS3.cpp:220 opens the port at.

        Both are the module found on the bench, not a property of the
        product: the T-Watch ships a MIA-M10Q *or* a Quectel LS550G, and
        one read-off does not retire that. A unit with the other part
        changes these two symbols and nothing else.

        Nothing here sweeps. A receiver whose rate you do not know is a
        bring-up question, and firmware/main/gnss_bridge.cpp is the
        instrument that answers it -- and its own log records why a sweep
        that scores on byte count picks noise over speech.
endmenu
```
